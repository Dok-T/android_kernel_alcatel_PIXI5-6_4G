## drivers/input/ft9338/Kconfig
```kconfig
config FINGERPRINT_FT9338
  bool FINGERPRINT_FT9338
  default n
  help
    focal-tech fingerprint driver
```

## drivers/input/gsl6272S/Kconfig
```kconfig
config FINGERPRINT_GSL6272S
  bool FINGERPRINT_GSL6272S
  default n
  help
    silead fingerprint driver
```

## drivers/misc/mediatek/accelerometer/bma2xx-new/Kconfig
```kconfig
config MTK_BMA2XX_NEW
	bool "MTK_BMA2XX_NEW for MediaTek package"
	default n
	help
	  It support different accelerometer sensor.
	  If this option is set,it will support bma2xx accelerometer driver.
```
